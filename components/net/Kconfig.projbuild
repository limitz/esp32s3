## components/net/Kconfig.projbuild
```kconfig
menu "WIPKAT WIFI"

	config WIPKAT_WIFI
		bool "Enable WiFi"
		default n
		help
			Enable a WiFi connection
	
	config WIPKAT_WIFI_SSID
		depends on WIPKAT_WIFI
		string "WiFi SSID"
		default "WIPKATNET"
		help
			SSID. WiFi network name to connect to

	config WIPKAT_WIFI_PASSWORD
		depends on WIPKAT_WIFI
		string "WiFi password"
		default "password"
		help
			WiFi password (WPA / WPA2) for the network to connect to

endmenu
```

## example/main/Kconfig.projbuild
```kconfig
menu "Example config"
	menuconfig WIPKAT_WIFI
		bool "WiFi"
		default n

		config WIPKAT_WIFI_SSID
			depends on WIPKAT_WIFI
			string "WiFi SSID"

		config WIPKAT_WIFI_PASSWORD
			depends on WIPKAT_WIFI
			string "WiFi password"

	menuconfig WIPKAT_SERVO_1
		bool "Servo 1"
		default y


		config WIPKAT_SERVO_1_CHANNEL
			depends on WIPKAT_SERVO_1
			int "Servo channel"
			default 0

		config WIPKAT_SERVO_1_PIN
			depends on WIPKAT_SERVO_1
			int "Pin number"
			default 17

		config WIPKAT_SERVO_1_MIN
			depends on WIPKAT_SERVO_1
			int "Min value (us)"
			default 800

		config WIPKAT_SERVO_1_MAX
			depends on WIPKAT_SERVO_1
			int "Max value (us)"
			default 1200

	
	menuconfig WIPKAT_SERVO_2
		bool "Servo 2"
		default y


		config WIPKAT_SERVO_2_CHANNEL
			depends on WIPKAT_SERVO_2
			int "Servo channel"
			default 1

		config WIPKAT_SERVO_2_PIN
			depends on WIPKAT_SERVO_2
			int "Pin number"
			default 18

		config WIPKAT_SERVO_2_MIN
			depends on WIPKAT_SERVO_2
			int "Min value (us)"
			default 800

		config WIPKAT_SERVO_2_MAX
			depends on WIPKAT_SERVO_2
			int "Max value (us)"
			default 1200
endmenu
	
```
